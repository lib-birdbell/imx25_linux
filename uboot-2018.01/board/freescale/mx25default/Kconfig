## uboot-2018.01/board/freescale/mx25default/Kconfig
```kconfig
if TARGET_MX25DEFAULT

config SYS_BOARD
	default "mx25default"

config SYS_VENDOR
	default "freescale"

config SYS_SOC
	default "mx25"

config SYS_CONFIG_NAME
	default "mx25default"

endif
```

## uboot-2018.01/configs/mx25default_defconfig
```kconfig
CONFIG_ARM=y
CONFIG_ARCH_MX25=y
CONFIG_TARGET_MX25DEFAULT=y
CONFIG_SYS_EXTRA_OPTIONS="IMX_CONFIG=board/freescale/mx25default/imximage.cfg"
CONFIG_DEFAULT_FDT_FILE="imx25-default.dtb"
CONFIG_HUSH_PARSER=y
CONFIG_CMD_BOOTZ=y
# CONFIG_CMD_FLASH is not set
CONFIG_CMD_I2C=y
CONFIG_CMD_MMC=y
# CONFIG_CMD_SETEXPR is not set
CONFIG_CMD_DHCP=y
CONFIG_CMD_MII=y
CONFIG_CMD_PING=y
CONFIG_CMD_CACHE=y
CONFIG_CMD_DATE=y
CONFIG_CMD_FS_GENERIC=y
CONFIG_DOS_PARTITION=y
CONFIG_ENV_IS_IN_MMC=y
CONFIG_FS_FAT=y
CONFIG_OF_LIBFDT=y
CONFIG_NAND=y
CONFIG_NAND_MXC=y
# CONFIG_SYS_NAND_BUSWIDTH_16BIT is not set
CONFIG_CMD_NAND=y
# CONFIG_CMD_NAND_TRIMFFS is not set
# CONFIG_CMD_NAND_LOCK_UNLOCK is not set
# CONFIG_CMD_NAND_TORTURE is not set
CONFIG_MTDIDS_DEFAULT=""
CONFIG_MTDPARTS_DEFAULT=""
```
